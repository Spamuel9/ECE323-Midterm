; This subroutine, named TIMER32_1_IRQHandler, acts as an interrupt handler for the TMR32B1 timer. It's tasked with responding to interrupts generated by specific match registers within the timer (MR0 and MR3). Depending on which match register triggers the interrupt, the subroutine manipulates the state of a GPIO pin (PIO1_4), setting it either high or low. This functionality is useful for tasks that require precise timing and control, such as PWM output or signal generation.

 AREA PROGRAM, CODE, READONLY
 EXPORT TIMER32_1_IRQHandler
 INCLUDE LPC11xx.inc
 
TIMER32_1_IRQHandler
	PUSH{R0-R6,LR} ; Saves the state of registers R0-R6 and the Link Register to preserve the current execution context.

	; Retrieves the interrupt register (IR) value to determine the cause of the interrupt and then clears the specified interrupts.
	LDR R0, =TMR32B1IR
	LDR R2, [R0]	; Loads the interrupt status into R2.
	MOVS R1, #0x9 ; Prepares a mask for interrupts MR0 and MR3.
	STR R1, [R0] ; Clears the interrupts by writing the mask.

	; Checks for an MR0 interrupt, which indicates a specific timing event has occurred.
check_MR0	
	MOVS R6, #1
	ANDS R6, R6, R2 ; Applies a mask to isolate the MR0 interrupt bit.
	BEQ check_MR3 ; If MR0 is not set, checks MR3 next.

int_MR0
	; Implements a brief delay to ensure synchronization with the MR3 interrupt, if necessary.
	PUSH{R0-R2}
	POP{R0-R2}

	; If an MR0 interrupt occurred, sets the PIO1_4 pin low to signal the event.
	LDR R0, =GPIO1DATA
	LDR R3, [R0]	; Loads the current GPIO data.
	MOVS R1, #0x10	; Specifies the bit for PIO1_4.
	BICS R3, R3, R1	; Clears the bit, setting PIO1_4 low.
	STR R3, [R0]	; Updates the GPIO data register.

	; Proceeds to check for an MR3 interrupt.
check_MR3
	MOVS R6, #1
	LSRS R2, R2, #3	; Shifts the interrupt status to isolate the MR3 bit.
	ANDS R6, R6, R2
	BEQ exit	; Exits if the MR3 interrupt is not set.

int_MR3
	; Responds to an MR3 interrupt by setting PIO1_4 high, reversing the action taken for an MR0 interrupt.
	LDR R0, =GPIO1DATA
	LDR R3, [R0]	; Retrieves the current GPIO data.
	MOVS R1, #0x10	; Specifies the bit for PIO1_4.
	ORRS R3, R3, R1	; Sets the bit, driving PIO1_4 high.
	STR R3, [R0]	; Commits the updated GPIO data.

exit
	POP{R0-R6,PC} ; Restores the saved registers and returns from the interrupt, resuming normal execution flow.
	ALIGN
	END
