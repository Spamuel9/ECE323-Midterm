; LPC11xx.inc
; defines for LPC11xx MMRs
IOCON_BASE_ADDR			EQU	 0x40044000
IOCON_PIO2_6 			EQU	(IOCON_BASE_ADDR + 0x000)
IOCON_PIO2_0 			EQU	(IOCON_BASE_ADDR + 0x008)
IOCON_RESET_PIO0_0 		EQU	(IOCON_BASE_ADDR + 0x00C)
IOCON_PIO0_1 			EQU	(IOCON_BASE_ADDR + 0x010)
IOCON_PIO1_8 			EQU	(IOCON_BASE_ADDR + 0x014)
IOCON_SSEL1_LOC			EQU	(IOCON_BASE_ADDR + 0x018)
IOCON_PIO0_2 			EQU	(IOCON_BASE_ADDR + 0x01C)
IOCON_PIO2_7			EQU	(IOCON_BASE_ADDR + 0x020)
IOCON_PIO2_8 			EQU	(IOCON_BASE_ADDR + 0x024)
IOCON_PIO2_1 			EQU	(IOCON_BASE_ADDR + 0x028)
IOCON_PIO0_3 			EQU	(IOCON_BASE_ADDR + 0x02C)
IOCON_PIO0_4 			EQU	(IOCON_BASE_ADDR + 0x030)
IOCON_PIO0_5 			EQU	(IOCON_BASE_ADDR + 0x034)
IOCON_PIO1_9 			EQU	(IOCON_BASE_ADDR + 0x038)	
IOCON_PIO3_4 			EQU	(IOCON_BASE_ADDR + 0x03C)
IOCON_PIO2_4 			EQU	(IOCON_BASE_ADDR + 0x040)	
IOCON_PIO2_5 			EQU	(IOCON_BASE_ADDR + 0x044)
IOCON_PIO3_5 			EQU	(IOCON_BASE_ADDR + 0x048)	
IOCON_PIO0_6 			EQU	(IOCON_BASE_ADDR + 0x04C)	
IOCON_PIO0_7 			EQU	(IOCON_BASE_ADDR + 0x050)
IOCON_PIO2_9 			EQU	(IOCON_BASE_ADDR + 0x054)
IOCON_PIO2_10 			EQU	(IOCON_BASE_ADDR + 0x058)
IOCON_PIO2_2 			EQU	(IOCON_BASE_ADDR + 0x05C)
IOCON_PIO0_8 			EQU	(IOCON_BASE_ADDR + 0x060)
IOCON_PIO0_9 			EQU	(IOCON_BASE_ADDR + 0x064)
IOCON_SWCLK_PIO0_10		EQU	(IOCON_BASE_ADDR + 0x068)
IOCON_PIO1_10 			EQU	(IOCON_BASE_ADDR + 0x06C)
IOCON_PIO2_11 			EQU	(IOCON_BASE_ADDR + 0x070)
IOCON_R_PIO0_11			EQU	(IOCON_BASE_ADDR + 0x074)
IOCON_R_PIO1_0			EQU	(IOCON_BASE_ADDR + 0x078)
IOCON_R_PIO1_1			EQU	(IOCON_BASE_ADDR + 0x07C)
IOCON_R_PIO1_2			EQU	(IOCON_BASE_ADDR + 0x080)
IOCON_PIO3_0			EQU	(IOCON_BASE_ADDR + 0x084)	
IOCON_PIO3_1			EQU	(IOCON_BASE_ADDR + 0x088)
IOCON_PIO2_3			EQU	(IOCON_BASE_ADDR + 0x08C)
IOCON_SWDIO_PIO1_3		EQU	(IOCON_BASE_ADDR + 0x090)
IOCON_PIO1_4			EQU	(IOCON_BASE_ADDR + 0x094)
IOCON_PIO1_11			EQU	(IOCON_BASE_ADDR + 0x098)
IOCON_PIO3_2			EQU	(IOCON_BASE_ADDR + 0x09C)	
IOCON_PIO1_5			EQU	(IOCON_BASE_ADDR + 0x0A0)
IOCON_PIO1_6 			EQU	(IOCON_BASE_ADDR + 0x0A4)	
IOCON_PIO1_7 			EQU	(IOCON_BASE_ADDR + 0x0A8) 
IOCON_PIO3_3 			EQU	(IOCON_BASE_ADDR + 0x0AC)
IOCON_SCK0_LOC			EQU	(IOCON_BASE_ADDR + 0x0B0)
IOCON_DSR_LOC			EQU	(IOCON_BASE_ADDR + 0x0B4)
IOCON_DCD_LOC			EQU	(IOCON_BASE_ADDR + 0x0B8)
IOCON_RI_LOC			EQU	(IOCON_BASE_ADDR + 0x0BC)
IOCON_CT16B0_CAP0_LOC	EQU	(IOCON_BASE_ADDR + 0x0C0)
IOCON_SCK1_LOC			EQU	(IOCON_BASE_ADDR + 0x0C4)
IOCON_MISO1_LOC			EQU	(IOCON_BASE_ADDR + 0x0C8)
IOCON_MOSI1_LOC			EQU	(IOCON_BASE_ADDR + 0x0CC)
IOCON_CT32B0_CAP0_LOC 	EQU	(IOCON_BASE_ADDR + 0x0D0)
IOCON_RXD_LOC		  	EQU	(IOCON_BASE_ADDR + 0x0D4)
	
	
GPIO0DIR		EQU	0x50008000
GPIO1DIR		EQU 0x50018000
GPIO2DIR		EQU 0x50028000
GPIO3DIR		EQU 0x50038000
	
GPIO0DATA 		EQU 0x50003FFC
GPIO1DATA 		EQU 0x50013FFC
GPIO2DATA 		EQU 0x50023FFC
GPIO3DATA 		EQU 0x50033FFC

SYSAHBCLKCTRL	EQU	0x40048080

NVIC			EQU	0xE000E100
ISER			EQU	0xE000E100
ICPR			EQU 0xE000E280

LPC_GPIO0IS		EQU 0x50008004 
LPC_GPIO1IS		EQU 0x50018004 
LPC_GPIO2IS		EQU 0x50028004  
LPC_GPIO3IS		EQU 0x50038004 

LPC_GPIO0IEV	EQU 0x5000800C 
LPC_GPIO1IEV	EQU 0x5001800C 
LPC_GPIO2IEV	EQU 0x5002800C  
LPC_GPIO3IEV	EQU 0x5003800C

LPC_GPIO0IE		EQU 0x50008010 
LPC_GPIO1IE		EQU 0x50018010 
LPC_GPIO2IE		EQU 0x50028010  
LPC_GPIO3IE		EQU 0x50038010

LPC_GPIO0IC		EQU 0x5000801C 
LPC_GPIO1IC		EQU 0x5001801C 
LPC_GPIO2IC		EQU 0x5002801C  
LPC_GPIO3IC		EQU 0x5003801C
	
;Timer control definitions
;;Match control register
TMR32B0MCR   EQU	0x40014014
TMR32B1MCR   EQU	0x40018014
TMR16B0MCR	 EQU	0x4000C014
TMR16B1MCR	 EQU	0x40010014
	
;;Timer Counter
TMR32B0TC 	 EQU    0x40014008 
TMR32B1TC 	 EQU    0x40018008 
TMR16B0TC	 EQU	0x4000C008
TMR16B1TC	 EQU	0x40010008

;;Timer Control Register
TMR32B0TCR 	 EQU	0x40014004
TMR32B1TCR 	 EQU	0x40018004
TMR16B0TCR	 EQU	0x4000C004
TMR16B1TCR	 EQU	0x40010004	
	
;;Prescale Register
TMR32B0PR 	 EQU 	0x4001400C
TMR32B1PR	 EQU	0x4001800C
TMR16B0PR	 EQU	0x4000C00C
TMR16B1PR	 EQU	0x4001000C

;;Match Registers 
TMR32B0MR0	 EQU	0x40014018
TMR32B0MR1	 EQU	0x4001401C
TMR32B0MR2	 EQU	0x40014020
TMR32B0MR3	 EQU	0x40014024
	
TMR32B1MR0	 EQU	0x40018018
TMR32B1MR1	 EQU	0x4001801C
TMR32B1MR2	 EQU	0x40018020
TMR32B1MR3	 EQU	0x40018024
	
TMR16B0MR0	 EQU	0x4000C018
TMR16B0MR1	 EQU	0x4000C01C
TMR16B0MR2	 EQU	0x4000C020
TMR16B0MR3	 EQU	0x4000C024

TMR16B1MR0	 EQU	0x40010018
TMR16B1MR1	 EQU	0x4001001C
TMR16B1MR2	 EQU	0x40010020
TMR16B1MR3	 EQU	0x40010024
	
;;External Match Register
TMR32B0EMR 	 EQU 	0x4001403C
TMR32B1EMR 	 EQU 	0x4001803C
	
;;Interrupt Register
TMR32B0IR	 EQU	 0x40014000
TMR32B1IR	 EQU	 0x40018000	
TMR16B0IR	 EQU	 0x4000C000
TMR16B1IR	 EQU 	 0x40010000
	
;;PWM Control Register
TMR32B0PWMC  EQU 	 0x40014074
TMR32B1PWMC  EQU 	 0x40018074	
TMR16B0PWMC	 EQU	 0x4000C074
TMR16B1PWMC	 EQU	 0x40010074
 
TMR32B0CCR	 EQU	 0x40014028
TMR32B0CR0	 EQU	 0x4001402C
 
	END 
